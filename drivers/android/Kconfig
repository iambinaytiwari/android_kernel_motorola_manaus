## drivers/android/Kconfig
```kconfig
# SPDX-License-Identifier: GPL-2.0-only
menu "Android"

config ANDROID_BINDER_IPC
	bool "Android Binder IPC Driver"
	depends on MMU
	default y
	help
	  Binder is an IPC mechanism which supports features such as
	  reference counting of shared objects, synchronous IPC calls
	  over shared memory, a simple shared-memory-based protocol,
	  and a process-refcounted means of exporting operations to
	  other processes.

	  If unsure, say Y.

config ANDROID_BINDERFS
	bool "Android Binderfs filesystem"
	depends on ANDROID_BINDER_IPC
	default y
	help
	  Binderfs is a pseudo-filesystem for the Android binder IPC driver
	  which can be mounted per-ipc namespace, allowing to use binder
	  in containers.

	  If unsure, say Y.

config ANDROID_BINDER_DEVICES
	string "Android Binder devices"
	depends on ANDROID_BINDER_IPC
	default "binder,hwbinder,vndbinder"
	help
	  Default value for the binder.devices parameter.

	  The binder.devices parameter is a comma-separated list of strings
	  that specifies the names of the binder device nodes that will be
	  created. Each name will correspond to a unique /dev/binder<name>
	  device node.

config ANDROID_BINDER_IPC_SELFTEST
	bool "Android Binder IPC Driver Selftest"
	depends on ANDROID_BINDER_IPC
	help
	  This feature allows binder to start a self test in order to check
	  whether a 32-bit userspace application can communicate with a 64-bit
	  kernel. If unsure, say N.

config ANDROID_VENDOR_HOOKS
	bool "Android Vendor Hooks"
	depends on TRACEPOINTS
	help
	  Enable vendor hooks in Android Common Kernel

config ANDROID_DEBUG_SYMBOLS
	bool "Android Debug Symbols"
	help
	  Enable debug symbols in Android Common Kernel

config ANDROID_KABI_RESERVE
	bool "Android KABI Reserve"
	default y
	help
	  Android KABI Reserve

source "drivers/android/binder_latency_tracer/Kconfig"

endmenu
```

## fs/f2fs/Kconfig
```kconfig
# SPDX-License-Identifier: GPL-2.0
config F2FS_FS
	tristate "F2FS filesystem support"
	depends on BLOCK
	select BUFFER_HEAD
	select CRYPTO
	select CRYPTO_CRC32
	select FS_ENCRYPTION_ALGS if FS_ENCRYPTION
	select FS_VERITY_BUILTIN_SIGNATURES if FS_VERITY
	help
	  F2FS is based on Flash Friendly File System (F2FS) which supports
	  Flash NAND storage devices.

	  Please refer to Documentation/filesystems/f2fs.rst for more details.

config F2FS_STAT_FS
	bool "F2FS Status Information"
	depends on F2FS_FS
	default y
	help
	  /sys/kernel/debug/f2fs/status includes information of many internal
	  states of file system, and debug, which is suitable for tracking
	  filesystem forward progress.

	  If unsure, say Y.

config F2FS_FS_XATTR
	bool "F2FS extended attributes"
	depends on F2FS_FS
	default y
	help
	  Extended attributes are name:value pairs associated with inodes by
	  the kernel or by users (see the attr(5) manual page for details).

	  If unsure, say N.

config F2FS_FS_POSIX_ACL
	bool "F2FS POSIX Access Control Lists"
	depends on F2FS_FS_XATTR
	select FS_POSIX_ACL
	default y
	help
	  Posix Access Control Lists (ACLs) support permissions for users and
	  groups beyond the owner/group/world scheme.

	  If unsure, say N.

config F2FS_FS_SECURITY
	bool "F2FS Security Labels"
	depends on F2FS_FS_XATTR
	help
	  Security labels provide an access control facility to support
	  Linux Security Models (LSMs) accepted by Extended Attributes.
	  You'll need to enable this option if you plan to use the security
	  kernel modules, which then enable access control model (such as
	  AppArmor, SELinux, Smack, Tomoyo) on top of F2FS.

	  If unsure, say N.

config F2FS_CHECK_FS
	bool "F2FS consistency checking feature"
	depends on F2FS_FS
	help
	  Enables BUG_ON() which checks consistency of F2FS.

	  If unsure, say N.

config F2FS_FAULT_INJECTION
	bool "F2FS fault injection facility"
	depends on F2FS_FS
	help
	  Test F2FS to tolerate faults under dirty filesystem conditions.

	  If unsure, say N.

config F2FS_FS_COMPRESSION
	bool "F2FS Compression Support"
	depends on F2FS_FS
	select FS_COMPRESSION
	help
	  Support data compression using LZO/LZ4/ZSTD/LZORLE compress algorithms.

	  If unsure, say N.

config F2FS_FS_LZO
	bool "LZO compression support"
	depends on F2FS_FS_COMPRESSION
	select LZO_COMPRESS
	select LZO_DECOMPRESS
	default y
	help
	  Support LZO compress algorithm, if unsure, say Y.

config F2FS_FS_LZ4
	bool "LZ4 compression support"
	depends on F2FS_FS_COMPRESSION
	select LZ4_COMPRESS
	select LZ4_DECOMPRESS
	default y
	help
	  Support LZ4 compress algorithm, if unsure, say Y.

config F2FS_FS_LZ4HC
	bool "LZ4HC compression support"
	depends on F2FS_FS_COMPRESSION
	depends on F2FS_FS_LZ4
	select LZ4HC_COMPRESS
	default y
	help
	  Support LZ4HC compress algorithm, if unsure, say Y.

config F2FS_FS_ZSTD
	bool "ZSTD compression support"
	depends on F2FS_FS_COMPRESSION
	select ZSTD_COMPRESS
	select ZSTD_DECOMPRESS
	default y
	help
	  Support ZSTD compress algorithm, if unsure, say Y.

config F2FS_FS_LZORLE
	bool "LZO-RLE compression support"
	depends on F2FS_FS_COMPRESSION
	depends on F2FS_FS_LZO
	default y
	help
	  Support LZO-RLE compress algorithm, if unsure, say Y.

config F2FS_IOSTAT
	bool "F2FS IO statistics information"
	depends on F2FS_FS
	default y
	help
	  Support getting IO statistics through sysfs and printing out periodic
	  IO statistics tracepoint events. You have to turn on "iostat_enable"
	  sysfs node to enable this feature.

config F2FS_UNFAIR_RWSEM
	bool "F2FS unfair rw_semaphore"
	depends on F2FS_FS && BLK_CGROUP
	help
	  Use unfair rw_semaphore, if system configured IO priority by block
	  cgroup.

config MTK_F2FS_DEBUG
	bool "mtk F2FS debug patch for userdebug and eng load"
	help
	  mtk F2FS debug patch for userdebug and eng load
```

## fs/fuse/Kconfig
```kconfig
# SPDX-License-Identifier: GPL-2.0-only
config FUSE_FS
	tristate "FUSE (Filesystem in Userspace) support"
	select FS_POSIX_ACL
	help
	  With FUSE it is possible to implement a fully functional filesystem
	  in a userspace program.

	  There's also a companion library: libfuse.  This library is
	  available from the FUSE homepage:
	  <https://github.com/libfuse/libfuse>
	  although it may also be available from your distributor.

	  You also need userspace tools to use FUSE.  Library and tools
	  can be downloaded from the homepage.

	  If you want to develop a userspace FS, or if you want to use
	  a network filesystem based on FUSE (CABSFUSE, EncFS, SSHFS, etc.)
	  then say Y or M.  To compile the FUSE core as a module, choose M.
	  The module will be called fuse.

	  If unsure, say N.

config CUSE
	tristate "Character device in Userspace support"
	depends on FUSE_FS
	help
	  This FUSE extension allows character devices to be
	  implemented in userspace.

	  If unsure, say N.

config FUSE_VIRTIO
	bool "Virtio Filesystem"
	depends on FUSE_FS
	select VIRTIO
	help
	  The Virtio Filesystem allows guests to mount a file system
	  exported from the host.

	  If you want to share files between guests and the host, then
	  say Y or M. To compile this driver as a module, choose M. The
	  module will be called virtiofs.

	  If unsure, say N.

config FUSE_DAX
	bool "Virtio Filesystem DAX support"
	depends on FUSE_VIRTIO
	depends on FS_DAX
	help
	  Allow DAX support on Virtio Filesystem.

	  If you want to allow mounting a Virtio Filesystem with the "dax"
	  option, answer Y.

config FUSE_BPF
	bool "Adds BPF to fuse"
	depends on FUSE_FS
	depends on BPF
	help
	  Extends FUSE by adding BPF to prefilter calls and potentially pass to a
	  backing file system

config MTK_FUSE_PASSTHROUGH_MTIME_UPDATE
	bool "update file time in passthrough path"
	help
	  This is a temporary config used for mtk userdebug and eng load to fix
	  the file time issue when passthrough is used.
```
